## configs/apple_m1_defconfig
```kconfig
CONFIG_ARM=y
CONFIG_ARCH_APPLE=y
# CONFIG_DISPLAY_CPUINFO is not set
# CONFIG_MMC is not set
# CONFIG_NET is not set
# CONFIG_SIMPLE_PANEL is not set
CONFIG_S5P_SERIAL=y
CONFIG_VIDEO_SIMPLE=y
# CONFIG_REQUIRE_SERIAL_CONSOLE is not set
CONFIG_DISPLAY_BOARDINFO_LATE=y
CONFIG_NVME_APPLE=y
CONFIG_USB_XHCI_HCD=y
CONFIG_USB_XHCI_PCI=y
CONFIG_USB_XHCI_DWC3=y
CONFIG_USB_KEYBOARD=y
CONFIG_USB_STORAGE=y
CONFIG_USE_PREBOOT=y
CONFIG_PREBOOT="pci enum; nvme scan; usb start"
CONFIG_EFI_LOADER_BOUNCE_BUFFER=y
```

## fs/apfs/Kconfig
```kconfig
config FS_APFS
	bool "Enable APFS filesystem support"
	help
	  This provides support for reading images from Apple's APFS.
```
